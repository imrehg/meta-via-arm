## conf/layer.conf
```bitbake
# We have a conf and classes directory, add to BBPATH
BBPATH .= ":${LAYERDIR}"

# We have recipes-* directories, add to BBFILES
BBFILES += "${LAYERDIR}/recipes-*/*/*.bb \
	${LAYERDIR}/recipes-*/*/*.bbappend"

BBFILE_COLLECTIONS += "vab820-bsp"
BBFILE_PATTERN_vab820-bsp = "^${LAYERDIR}/"
BBFILE_PRIORITY_vab820-bsp = "6"

LAYERDEPENDS_vab820-bsp = "fsl-arm"
LAYERVERSION_vab820-bsp = "1"
```

## conf/machine/include/vab820.inc
```bitbake
# Common settings for VAB-820 boards

include conf/machine/include/imx-base.inc
include conf/machine/include/tune-cortexa9.inc

PREFERRED_PROVIDER_u-boot ?= "u-boot-vab820"
PREFERRED_PROVIDER_virtual/kernel ?= "linux-vab820"
PREFERRED_VERSION_linux-vab820 ?= "3.10.17"

SERIAL_CONSOLE = "115200 ttymxc1"

MACHINE_FEATURES += " pci rtc"

KERNEL_IMAGETYPE = "uImage"

IMX_TEST_SUPPORT = "y"
```

## conf/machine/vab820-quad.conf
```bitbake
#@TYPE: Machine
#@NAME: VIA VAB-820 Quad
#@SOC: i.MX6Q
#@DESCRIPTION: Machine configuration for VIA VAB-820 quad board
#@MAINTAINER: Gergely Imreh <gergelyimreh@via.com.tw>

require conf/machine/include/vab820.inc

SOC_FAMILY = "mx6:mx6q:vab820"

KERNEL_DEVICETREE ?= "imx6q-vab820.dtb"

UBOOT_MACHINE ?= "mx6qvab820"

MACHINE_FEATURES += ""
```
